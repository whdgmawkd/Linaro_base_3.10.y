## arch/arm64/configs/exynos5433-tre3calteskt_defconfig
```kconfig
# CONFIG_NFC_PN547 is not set
# CONFIG_NFC_PN547_CLOCK_REQUEST is not set
# CONFIG_SENSORS_MAX86900 is not set
# CONFIG_SEC_MODEM_V1 is not set
# CONFIG_SEC_MODEM_XMM7260_CAT6 is not set
# CONFIG_USB_EHCI_HCD is not set
# CONFIG_USB_EHCI_S5P is not set
# CONFIG_SAMSUNG_USB2PHY is not set
# CONFIG_IRLED_PEEL is not set
CONFIG_INPUT_WACOM=y
CONFIG_EPEN_WACOM_W9012=y
CONFIG_LCD_HMT=y
CONFIG_FB_WINDOW_UPDATE_EN=y
CONFIG_AVERAGE=y
CONFIG_SENSORS_ADPD142=y
CONFIG_SENSORS_MAX86902=y
CONFIG_SENSORS_MAX_NOTCHFILTER=y
CONFIG_SEC_NFC=y
CONFIG_SEC_NFC_IF_I2C=y
CONFIG_SEC_NFC_PRODUCT_N5=y
CONFIG_SEC_NFC_CLK_REQ=y
CONFIG_SEC_NFC_MARGINTIME=y
CONFIG_SND_SOC_SAMSUNG_PACIFIC_FLORIDA=y
CONFIG_SND_SOC_MAX98504A=y
CONFIG_SND_USE_3MICS=y
CONFIG_SND_SAMSUNG_COMPENSATE_EXT_RES=y
CONFIG_GPS_BCM4773=y
CONFIG_SEC_MODEM_V1=y
CONFIG_EXYNOS_MIPI_LLI_GPIO_SIDEBAND=y
CONFIG_UMTS_MODEM_SS333=y
CONFIG_TDMB=y
CONFIG_TDMB_VENDOR_RAONTECH=y
CONFIG_TDMB_MTV319=y
CONFIG_TDMB_I2C=y
CONFIG_TDMB_TSIF_SLSI=y
CONFIG_TDMB_SLSI=y
CONFIG_WLAN_REGION_CODE=201
CONFIG_XFRM=y
CONFIG_INET_IPCOMP=y
CONFIG_SENSORHUB_S333=y
CONFIG_TCP_CONG_ADVANCED=y
CONFIG_TCP_CONG_BIC=y
CONFIG_DEFAULT_BIC=y
CONFIG_DEFAULT_TCP_CONG=bic
CONFIG_CRYPTO_HMAC=y
CONFIG_CRYPTO_XCBC=y
CONFIG_CRYPTO_MD5=y
CONFIG_CRYPTO_DES=y
CONFIG_CRYPTO_DEFLATE=y
CONFIG_SWAP=y
CONFIG_FRONTSWAP=y
CONFIG_ZSMALLOC_NEW=y
CONFIG_PGTABLE_MAPPING=y
CONFIG_ZSWAP=y
CONFIG_DIRECT_RECLAIM_FILE_PAGES_ONLY=y
CONFIG_INCREASE_MAXIMUM_SWAPPINESS=y
CONFIG_FIX_INACTIVE_RATIO=y
CONFIG_TIGHT_PGDAT_BALANCE=y
CONFIG_VNSWAP=y
CONFIG_SWAP_ENABLE_READAHEAD=n
CONFIG_USB_LOCK_SUPPORT_FOR_MDM=y
CONFIG_IRLED_WATCHON=y
CONFIG_MMC_DW_FMP_DM_CRYPT=y
CONFIG_BUFFERED_PTRACK=y
CONFIG_CAMERA_SYSFS_V2=y
CONFIG_CAMERA_TRE=y
```
